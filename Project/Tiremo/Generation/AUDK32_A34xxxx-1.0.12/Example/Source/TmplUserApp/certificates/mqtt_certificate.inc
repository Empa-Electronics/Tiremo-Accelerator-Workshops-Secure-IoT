static const char __attribute__((section(".cert_flash"))) s_mqtt_client_cert[] =
"-----BEGIN CERTIFICATE-----\n"
"MIIDWTCCAkGgAwIBAgIUeClDCpOmxx/bQ1fDW28oFk1hOKcwDQYJKoZIhvcNAQEL\n"
"BQAwTTFLMEkGA1UECwxCQW1hem9uIFdlYiBTZXJ2aWNlcyBPPUFtYXpvbi5jb20g\n"
"SW5jLiBMPVNlYXR0bGUgU1Q9V2FzaGluZ3RvbiBDPVVTMB4XDTI2MDYxMjA5NTcz\n"
"N1oXDTQ5MTIzMTIzNTk1OVowHjEcMBoGA1UEAwwTQVdTIElvVCBDZXJ0aWZpY2F0\n"
"ZTCCASIwDQYJKoZIhvcNAQEBBQADggEPADCCAQoCggEBAL4OGiTUOAy/Vgmcu7tS\n"
"/5s3rjTjn6vJ3BboMqI6m0Kq4xM+HPfExHhsD7C4EubquNQnw5lMCuIK1D+Xduoh\n"
"+iPSwkUMHE1MeaQqyYFCSgarZbSvjbimKdYXLk3ZwaADPdz6AxS/0wku0bjrq1Dl\n"
"1cflqJeDTN13mCQglElfDkCyCeErPdQAFa+jQiRYRCJ88y3U4EQ5S7A7j5Zoik1D\n"
"avYkZ9z58i21w6mWRLKzPlNGbBXZ2EcZKFS+vZcfpQ5iCtQHC9pl5f5wvsr77KOY\n"
"MTCMXSeoL4bC5t/ueh0bJ1/Mk95XZZZa00e+0GKOy70/M4AQZqQPPST4RHZ5j0oF\n"
"hPMCAwEAAaNgMF4wHwYDVR0jBBgwFoAUVqU9UV1YX7YhAHdYJrj8VsCBgA8wHQYD\n"
"VR0OBBYEFKFQiw11PflmGZTef1D+OKchnF/IMAwGA1UdEwEB/wQCMAAwDgYDVR0P\n"
"AQH/BAQDAgeAMA0GCSqGSIb3DQEBCwUAA4IBAQAYYYf9lykyjFHSJHxNzSuRaRcJ\n"
"ytW5Edv0bXlrRfdo/E+YMzdfps2Qxm+qngVoCFG9hENfk7QJN+yL/gEq60mRymIN\n"
"FAifAGBZsI9YXajHhpDrEp3dS40R6fGtiHYyLN68ysS1ZGJujIOLk4eLSUj6nk+A\n"
"RV7kTudkB3nqxEsB5W243dwZ1OWSMA+le5a99y8Ys37nq+Wzs7ESUfjRRBjqnNxl\n"
"Ipy+hEDq95mmKof3m3yFmvEul0JDwMPM6A+a+abe25fhSt/84kQZfrDBJB+ZrEj9\n"
"K/i3wUniEsXeZQeomvxv/Vpm2BxOCJgeZW4RnHGrpKvkT7Wnrajrtrfo5wn2\n"
"-----END CERTIFICATE-----\n";
