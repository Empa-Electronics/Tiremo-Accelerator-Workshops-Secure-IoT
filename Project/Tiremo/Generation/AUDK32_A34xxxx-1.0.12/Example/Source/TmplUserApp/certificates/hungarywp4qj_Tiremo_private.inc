/* Included from hungarywp4qj_Tiremo_private.key */
static const char s_mqtt_private_key[] =
    "-----BEGIN RSA PRIVATE KEY-----\n"
    "MIIEpQIBAAKCAQEA4HeBzn0VK/r8/eq52CpUpyH4unU73iO5CehEMwLxrcjSIWVN\n"
    "KCoQl4Y2YkAI7AdOj2ntyUVcWeYr0EJUN3ijpY+YEvbPyF42OXYY6a9RnRBPyA78\n"
    "icuXdN9pVkAQe+zP5eialE7q43pUZwQhtBTWt39PQQ5C/B5zM0wTR4jBuQoUa7qg\n"
    "XGnylcZw8lndnljV214XtmmB4kFU//ZvltJFftsPRpEJa4yje4/829KCLbp2wAzo\n"
    "dmHLWMj26uSloZ0vRu4sguhdPx1s1Gg6whIN7N0joPwSc/BqZ0Uerd+EqYXJ1Aaq\n"
    "jCgOWH5crcjnGnNoGB0zwNfcqDtNZG3B7WNNZQIDAQABAoIBAHgoQPpSBuVWI9ug\n"
    "rP9EGbCmBMl7PCL7qG/fP7K23ryShbmOyrC3Y85Y7//EG4KNnsYyhDF7yaXuCoIf\n"
    "H4naMG/N4DA2op+1nv0/dLKTQPL86lhDfXgd3eOYPIEJJknQSLHfw++kFyTSNSA4\n"
    "G/qUNSRhKAHBKqZffnd1P9TJJjpwZDErqiOrvy7wNsjMV1s7L3cd+hqw2r44Et+u\n"
    "CL/MqDb/tlNIsgmgDyHlGegcvsQF37kXpGF8qLhEMNeo29AMWh/ldvTL8SmyvvDX\n"
    "m8UMpr8O358EaOKiBEvAdGzdTYvVuCvwqQZs9+JT06Hwqhq4F0aIp4Wipq5oVK0J\n"
    "QDbSkLkCgYEA9F1PmP4TUpge/BDMtoAhPuMQr0gHvv1aM+BNrc+/h16ReKNzpO5B\n"
    "xJljRTQhLM0BN5cARzz8WkZU7UxT+wvZLqlcjQ3WFGxn2av/bmD3RRU23lzUV6DI\n"
    "KpWWo1DFpXh9wHDdRPxqpsg1sZI4jdhRFzeaYcJvM7L6+PygaE4am5MCgYEA6yen\n"
    "Hm62z26iNGGQp4IGLsOMOlKaDlMdF2fWHPbq/MwBZRx1qg75DIy1Un4YDpMr9dw+\n"
    "ZoRykzsTzwnk8+aLWIQAotdfYwmGxBiG1EFnDma8TZm1DED86WwKdFHOl05QJb8o\n"
    "mgF5Ucs/TJEmCvqEm+5rgz2K+BS9ExXtn6y4PicCgYEAt1SKMy3rMTwPguzXqNPY\n"
    "HWYdTmOr7A4HboQJwyzpdJXubaOzTzmw/d5WK8VAXmwvTZVsEAYhDVlWvfFV0DLD\n"
    "bc6CMREAW7I494WizRzSZnHUCF98r4FgqxIvQbeHkO0k6wvB9c+p9BagsegRpdl0\n"
    "fQaqPE2zQAY3ZDWj4p02OSECgYEAlczz3CIhWPEcaYwBj4P4FlBCA2FdfGSb8q4W\n"
    "Kuts9M+sz9Gab1QMeV8ln0BuaNJ+PagpJDuZlYsb6ldeP7WM7T1h/lp/DGMkM8WA\n"
    "FrT3RqhRqomRWRYJR1WpL0Jx/ddInVMyNTFdLKryTv9kIbhHQ+JVIQzSe4kSjZb5\n"
    "gi+QSx8CgYEAy//AzrR2Q9DRAbkT/HmTzklt9jrSq1IlXdWJ8k930Vh52BNRetBm\n"
    "lFBrzARfJ74eiJkegSUU26ULaB9FJ3xy4LG6ymTm2JHPl0/hEudiDC6IGNCxH5sl\n"
    "9G0h42wg+mE8oit06moEAS5qRaCQllpVuiMCMlwJY7CD5N5EYm8pal8=\n"
    "-----END RSA PRIVATE KEY-----\n"
    "\n";