static const char __attribute__((section(".cert_flash"))) s_mqtt_private_key[] =
"-----BEGIN RSA PRIVATE KEY-----\n"
"MIIEowIBAAKCAQEAvg4aJNQ4DL9WCZy7u1L/mzeuNOOfq8ncFugyojqbQqrjEz4c\n"
"98TEeGwPsLgS5uq41CfDmUwK4grUP5d26iH6I9LCRQwcTUx5pCrJgUJKBqtltK+N\n"
"uKYp1hcuTdnBoAM93PoDFL/TCS7RuOurUOXVx+Wol4NM3XeYJCCUSV8OQLIJ4Ss9\n"
"1AAVr6NCJFhEInzzLdTgRDlLsDuPlmiKTUNq9iRn3PnyLbXDqZZEsrM+U0ZsFdnY\n"
"RxkoVL69lx+lDmIK1AcL2mXl/nC+yvvso5gxMIxdJ6gvhsLm3+56HRsnX8yT3ldl\n"
"llrTR77QYo7LvT8zgBBmpA89JPhEdnmPSgWE8wIDAQABAoIBADS1tIqCUQk4B6Si\n"
"024glsN1rdr9RktesKupumFD38udmVy83UvaRqMfVTqt0pA4iQpN/PGHJX2Lg1If\n"
"r9s/kSBeU4LS2QaXLyVYuIog2GcBIjP6fFO5weCejTkKK6k1PPMMY85dZSom0gN3\n"
"WQwWsjO+fgOHZsoFYSyj3Hx84HcQb0Yi39CapXstetv6TC9dDjX+MRNl/9l2ydTs\n"
"297dhYooOdxvpCjf9suKzb6bwH2m2Q9tlI1goZqIHM172D28uDhF65Y2xNc02vff\n"
"d1AQ9qvQQb1S62ZGtx+RyxXR8sEqeaL2kKfBSQE2HrKswQ+w4yOlNEU3aEIl2PfR\n"
"1+1a2AECgYEA4wTeNNjLSlCzXw+SPbX6MMCh2kJcOla3ms0cuP4mdtj3Q/yAUeeQ\n"
"d6+vrLNMgtLALqZYXn0ZTwlskfzdavBaP5LeOAXdIfddRUEwOY8GVxhjKhtlcR4Z\n"
"cHXMfGK1fiIBXhA0X5PpmrOZOMgaTm3MznmyWwqyriHFyAcMsgeq5c0CgYEA1lE6\n"
"eO6qHf44I9lu7JkAFuQCstR31sQDdYXSV3Qp9kJkEch0NZAAy10IfblojEVg9lx7\n"
"j35u9jUZgO6k2cHKo79iAzVnCFZ9Il+CBVcoStDaIqGaghw84SSZRxXuje4O45Z4\n"
"1OgMeliqjRz/eqf7mB2vvJQ9RTARp0j2jtkTVb8CgYEAwtwB00CmtgIxBI58C0Yx\n"
"Gzmtc4d0XIrkjBY06kEUSP0QuKV6i1MFOQZu9wDr0nsNhL05qtkcKTBApcpzT4BB\n"
"JsJsxY+a8LW/tFsxBqbSXV3MeG8NkpuwYExsmfOsLzkHDXNBUSzH3gb8pLV1hw5O\n"
"NohU5Dp5hmfsuTX72rAkK50CgYADJVoYYFh67DpivFRWgMBxlZM8kMXZjzMFzJsT\n"
"0Y60ILFbWXfrOVvpoEn5nnkcZgBQXXcq2g5C6vCe5eHhmGijErIbnfMPOkXH9WLx\n"
"NSBQSNSK4ZhlBIkYPPNLCdVgm/f3+0N2zJkySo7mV2CgqkqVJwpnWD22AEiiDf4g\n"
"hqsz/QKBgE0VAI45bOh/X41dQNYydMWo6exRCaTYk36Q87hbxS/vzPEywk8Vgj0H\n"
"jpPovNRevdHHXRn3nEv+Bnlfte+WfWfV2amwbPuC1nrO5E26QAogGIUMrPe4tsJ0\n"
"K5Iae6iKNm8KLlsKNGJ3W9U7oGRbkhn/UKRC+fpyWm8Q1WvqdrKf\n"
"-----END RSA PRIVATE KEY-----\n";
